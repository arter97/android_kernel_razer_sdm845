## Documentation/devicetree/bindings/leds/leds-lm3644.txt
```
lm3644 led-controller provides a way to control two flash led path.

Required properties:
- compatible		: Should be "ti,lm3644".
- reg			: i2c slave addres, must be "0x63".

Optional properties:
- pinctrl-names		: Should be "default".
- pinctrl-0		: Pinctrl node with default initial setting.
- gpio-hwen		: Gpio number for "HWEN" pin, should be tunr on before use driver control method.
- gpio-strobe		: Gpio number for "STROBE" pin, if defined, driver would change to gpio control for turn on/off led
- gpio-torch		: Gpio number for "TORCH" pin, if defined, driver would change to gpio control for turn on/off led
- gpio-tx		: Gpio number for "TX" pin, but NOT-SUPPORT now.
- torch-ramp-time-ms	: Torch rampup time in ms, defaul: 1ms.
				(Valid: 0, 1, 32, 64, 128, 256, 512, 1024)
- flash-timeout-ms	: Flash auto timeout threshold in ms, default: 150ms/600ms for TT.
				(Valid: 10, 20, 30, 40, 50, 60, 70, 80, 90, 100, 150, 200, 250, 300, 350, 400)
				(Valid for TT: 40, 80, 120, 160, 200, 240, 280, 320, 360, 400, 600, 800, 1000, 1200, 1400, 1600)
- torch-override	: Boolean value, means LED1 torch brightness would be overrided with LED2's.
- flash-override	: Boolean value, means LED1 flash brightness would be overrided with LED2's.
- enable-ntc		: Boolean value, enable ntc feature, but NOT-SUPPORT now.
- boost-mode		: Boost mode, default: normal, valid: 0->normal, 1->pass mode only.
- boost-freq		: Boost freqency, default: 2Mz, valid: 0->2MHz, 1->4MHz.
- boost-climit		: Bosst current limitation, default: 2.8A, valid: 0->1.9A, 1->2.8A.
- led-fault-detect	: Detect LED pin short fault, default: enable, valid: 0->disable, 1->enable.

Child Node for led device:
Requried properties:
- id			: the led number of this chip, valid: 0~4, can't duplicate.
- led-mask		: led controlled bit mask (LED1 is bit0, LED2 is bit1), only switch node need this property.

Optional properties:
- max_brightness	: the max current for the specific led (Torch:180/360(TT), Flash:1500).
- led-name		: led device name, default: "flash0", "flash1", "torch0", "torch1", "switch0" (map to id number)
- led-trigger		: led trigger name, default is same as led-name.

Other properties:
- qcom,default-led-trigger: Seems like related to qcom camera, but not useful now.
- qcom,current-ma: Seems like related to qcom camera, but not useful now.
- qcom,max-current: Seems like related to qcom camera, but not useful now.
- qcom,duration-ms: Seems like related to qcom camera, but not useful now.

Example:
	lm3644@63 {
		compatible = "ti,lm3644";
		reg = <0x63>;
		status = "okay";

		pinctrl-names = "default";
		pinctrl-0 = <&sdm845_gpio16_default &sdm845_gpio22_default &sdm845_gpio3_default>;
		gpio-hwen = <&tlmm 16 0>;
		gpio-strobe = <&tlmm 22 0>;
		gpio-torch = <&tlmm 3 0>;
		torch-ramp-time-ms = <1>; //default
		flash-timeout-ms = <600>; //default
		led-fault-detect = <1>; //default
		boost-mode = <0>; //default
		boost-freq = <0>; //default
		boost-climit = <1>; //default

		lm3644_flash0: flash0 {
			id = <0>;
			led-name = "flash0";
			led-trigger = "flash0_trigger";
			max-brightness = <1200>; //mA

			qcom,default-led-trigger = "flash0_trigger"; //same as trigger
			qcom,current-ma = <730>; //default
			qcom,max-current = <1200>; //led limit
			qcom,duration-ms = <600>; //same as flash-timeout-ms
		};

		lm3644_torch0: torch0 {
			id = <2>;
			led-name = "torch0";
			led-trigger = "torch0_trigger";
			max-brightness = <360>; //mA

			qcom,default-led-trigger = "torch0_trigger";
			qcom,current-ma = <180>; //default
			qcom,max-current = <360>; //chip limit
		};

		lm3644_switch0: switch0 {
			id = <4>;
			led-name = "switch0";
			led-trigger = "switch0_trigger";
			led-mask = <3>;
			max-brightness = <1>;

			qcom,default-led-trigger = "switch0_trigger";
		};
	};
```

## Documentation/devicetree/bindings/misc/ts3a5018.txt
```
ts3a5018 switch provides a way to control which path to use.

Required properties:
- compatible	: Should be "ti,ts3a5018"
- vin-supply	: Power-supply handle node
- gpio-en	: Gpio number for "EN" pin
- en-fix-value	: If not set "gpio-en", then must set en-pin fixed value by design.
		  If gpio-en exists, this would be ignored.
- gpio-in	: Gpio number for "IN" pin
- in-fix-value	: If not set "gpio-in", then must set in-pin fixed value by design.
		  If gpio-in exists, this would be ignored.

Optional properties:
- pinctrl-names	: Should be "default"
- pinctrl-0	: Pinctrl node with default initial setting
- mode-labels	: Three strings array to instead of default label strings
		  (Default label strings: "NONE", "CLOSE", "OPEN")
- default-mode	: Integer value for mode(0: all-path off, 1: NC path, 2: NO path)

Example:
	asic-spi-sw {
		compatible = "ti,ts3a5018";
		status = "okay";

		vin-supply = <&pm8998_s4>;
		pinctrl-names = "default";
		pinctrl-0 = <&sdm845_gpio14_default>;
		en-fix-value = <0>;
		gpio-in = <&tlmm 14 0>;
		mode-labels = "NONE", "ASIC", "QCOM";
		default-mode = <1>; /* NC mode */
	};
```

## drivers/fih/Kconfig
```kconfig
#
# fih driver
#

menu "fih driver"

config FIH
	bool "fih"
	default n
	help
	  support fih


config FIH_RC2
	bool "fih_rc2"
	default n
	help
	  support fih_rc2

config FIH_APR
	bool "fih apr"
	depends on FIH
	default n
	help
	  support fih apr virtual file

config FIH_INFO
	bool "fih info"
	depends on FIH
	default n
	help
	  support fih info virtual file

config FIH_GPIO
	bool "fih gpio"
	depends on FIH
	default n
	help
	  support fih gpio function

config FIH_DDR
	bool "fih ddr"
	depends on FIH
	default n
	help
	  support fih ddr virtual file

config FIH_MFD
	bool "fih mfd"
	depends on FIH
	default n
	help
	  support fih mfd virtual file

config FIH_NV
	bool "fih nv"
	depends on FIH
	default n
	help
	  support fih nv function

config FIH_SUT
	bool "fih sut"
	depends on FIH
	default n
	help
	  support fih sut virtual file

config FIH_FVER
	bool "fih fver"
	depends on FIH
	default n
	help
	  support fih fver virtual file

config FIH_UFS
	bool "fih ufs"
	depends on FIH
	default n
	help
	  support fih ufs virtual file

config FIH_TOUCH
	bool "fih touch"
	depends on FIH
	default n
	help
	  support fih touch virtual file

config FIH_LOG
	bool "fih log"
	depends on FIH
	default n
	help
	  support fih log virtual file

config FIH_CDA
	bool "fih cda"
	depends on FIH
	default n
	help
	  support fih cda virtual file

config FIH_MFR
	bool "fih mfr"
	depends on FIH
	default y
	help
	  support fih mfr virtual file

config FIH_SAMP
	bool "fih samp"
	depends on FIH
	default n
	help
	  support fih samp virtual file

config FIH_SENSOR
	bool "fih sensor"
	depends on FIH
	default n
	help
	  support fih sensor virtual file

config FIH_USB
	bool "fih usb"
	default n
	help
	  support FIH USB Driver

config FIH_HAC
	bool "fih hac"
	default n
	help
	  support fih hac virtual file

config FIH_HALL_SENSOR
	bool "fih hall sensor"
	depends on FIH
	default n
	help
	  support fih hall sensor driver

config FIH_SENSOR_POWER
	bool "fih sensor power"
	depends on FIH
	default n
	help
	  support fih sensor power

config FIH_CPU
	bool "fih cpu"
	depends on FIH
	default n
	help
	  support fih cpu virtual file

config FIH_GYRO
	bool "fih gyro"
	depends on FIH
	default n
	help
	  support fih gyro virtual file

config FIH_ALSP
	bool "fih alsp"
	depends on FIH
	default n
	help
	  support fih alsp virtual file

config FIH_BATTERY
	bool "fih battery"
	depends on FIH
	default n
	help
	  support fih battery

config FIH_LCM
	bool "fih Lcm"
	depends on FIH
	default n
	help
	  support fih Lcm

config FIH_SUSPEND_RESUME_LOG
	bool "FIH LOG about suspend/resume"
	depends on FIH
	default n
	help
	  Enable more log for suspend/resume debugging.

config FIH_DUMP_WAKELOCK
	bool "Show wakelock info after screen off."
	depends on FIH
	default n
	help
	  Show active wakelock info after screen off.

config FIH_RPMH_MASTER_STATS
	bool "Show rpmh master stats."
	depends on FIH
	default n
	help
	  Show rpmh master stats when device resume from suspend.

config FIH_FOD_TEST
	bool "fih fod test"
	depends on FIH
	default n
	help
	  support fih fod battery
endmenu
```

## drivers/input/touchscreen/synaptics_3708/Kconfig
```kconfig
#
# Synaptics DSX touchscreen driver configuration
#
menuconfig TOUCHSCREEN_SYNAPTICS_3708
	bool "Synaptics DSX touchscreen"
	default y
	help
	  Say Y here if you have a Synaptics DSX touchscreen connected
	  to your system.

	  If unsure, say N.

if TOUCHSCREEN_SYNAPTICS_3708

choice
	default TOUCHSCREEN_SYNAPTICS_3708_I2C
	prompt "Synaptics DSX bus interface"
config TOUCHSCREEN_SYNAPTICS_3708_I2C
	bool "RMI over I2C"
	depends on I2C
config TOUCHSCREEN_SYNAPTICS_3708_SPI
	bool "RMI over SPI"
	depends on SPI_MASTER
config TOUCHSCREEN_SYNAPTICS_3708_RMI_HID_I2C
	bool "HID over I2C"
	depends on I2C
endchoice

config TOUCHSCREEN_SYNAPTICS_3708_CORE
	tristate "Synaptics DSX core driver module"
	depends on I2C || SPI_MASTER
	help
	  Say Y here to enable basic touch reporting functionality.

	  If unsure, say N.

	  To compile this driver as a module, choose M here: the
	  module will be called synaptics_3708_core.

config TOUCHSCREEN_SYNAPTICS_3708_RMI_DEV
	tristate "Synaptics DSX RMI device module"
	depends on TOUCHSCREEN_SYNAPTICS_3708_CORE
	help
	  Say Y here to enable support for direct RMI register access.

	  If unsure, say N.

	  To compile this driver as a module, choose M here: the
	  module will be called synaptics_3708_rmi_dev.

config TOUCHSCREEN_SYNAPTICS_3708_FW_UPDATE
	tristate "Synaptics DSX firmware update module"
	depends on TOUCHSCREEN_SYNAPTICS_3708_CORE
	help
	  Say Y here to enable support for doing firmware update.

	  If unsure, say N.

	  To compile this driver as a module, choose M here: the
	  module will be called synaptics_3708_fw_update.

config TOUCHSCREEN_SYNAPTICS_3708_TEST_REPORTING
	tristate "Synaptics DSX test reporting module"
	depends on TOUCHSCREEN_SYNAPTICS_3708_CORE
	help
	  Say Y here to enable support for retrieving production test reports.

	  If unsure, say N.

	  To compile this driver as a module, choose M here: the
	  module will be called synaptics_3708_test_reporting.

config TOUCHSCREEN_SYNAPTICS_3708_PROXIMITY
	tristate "Synaptics DSX proximity module"
	depends on TOUCHSCREEN_SYNAPTICS_3708_CORE
	help
	  Say Y here to enable support for proximity functionality.

	  If unsure, say N.

	  To compile this driver as a module, choose M here: the
	  module will be called synaptics_3708_proximity.

config TOUCHSCREEN_SYNAPTICS_3708_ACTIVE_PEN
	tristate "Synaptics DSX active pen module"
	depends on TOUCHSCREEN_SYNAPTICS_3708_CORE
	help
	  Say Y here to enable support for active pen functionality.

	  If unsure, say N.

	  To compile this driver as a module, choose M here: the
	  module will be called synaptics_3708_active_pen.

config TOUCHSCREEN_SYNAPTICS_3708_GESTURE
	tristate "Synaptics DSX user defined gesture module"
	depends on TOUCHSCREEN_SYNAPTICS_3708_CORE
	help
	  Say Y here to enable support for user defined gesture functionality.

	  If unsure, say N.

	  To compile this driver as a module, choose M here: the
	  module will be called synaptics_3708_gesture.

config TOUCHSCREEN_SYNAPTICS_3708_VIDEO
	tristate "Synaptics DSX video module"
	depends on TOUCHSCREEN_SYNAPTICS_3708_CORE
	help
	  Say Y here to enable support for video communication functionality.

	  If unsure, say N.

	  To compile this driver as a module, choose M here: the
	  module will be called synaptics_3708_video.

endif
```

## drivers/usb/tusb544/Kconfig
```kconfig
config USB_TUSB544
	tristate "TI I2C based redriver Driver for TUSB544"
	depends on I2C
	help
	  This enables the re-driver driver for TUSB544 based devices.
```
