
qcom,2930572_fih_rcl_4000mah_averaged_masterslave_feb9th2018 {
	qcom, = <24>;
	/* #2930572_FIH_RCL_4000mAh_averaged_MasterSlave_Feb9th2018*/
	qcom,max-voltage-uv = <4400000>;
	qcom,nom-batt-capacity-mah = <4000>;
	qcom,fastchg-current-ma = <3900>;
	qcom,batt-id-kohm = <240>;
	qcom,battery-beta = <4085>;
	qcom,fg-cc-cv-threshold-mv = <4390>;
	qcom,battery-type = "2930572_fih_rcl_4000mah_averaged_masterslave_feb9th2018";
	qcom,soc-based-step-chg;
	qcom,step-chg-ranges = <0	25	3900000
				26	100	1900000>;
	fih,step-chg-hysteresis = <0>;
	qcom,jeita-fcc-ranges = <0	159	750000
				 160	449	3900000
				 450	549	1900000>;
	qcom,jeita-fv-ranges = <0	440	4400000
				441	550	4100000>;
	fih,jeita-hysteresis = <9>;
	fih,wlc-fcc-ranges = <0	349	3900000
				 350	379	1250000
				 380	409	700000
				 410	549	400000>;
	qcom,checksum = <0x66A4>;
	qcom,gui-version = "PMI8998GUI - 2.0.0.58";
	qcom,fg-profile-data = [
		 82 1F A7 05
		 75 0A AB FC
		 E1 1C D1 FB
		 DC 0D 7B 0A
		 BF 17 DB 23
		 5E 44 58 5A
		 76 00 00 00
		 10 00 00 00
		 00 00 CD BD
		 47 CD 0C C3
		 18 00 08 00
		 55 E3 75 ED
		 1B FD D9 F3
		 87 05 1A 1A
		 E9 04 0A 32
		 19 06 09 20
		 27 00 14 00
		 1C 20 19 05
		 E1 0A E6 05
		 D3 1C C1 02
		 63 0C EB 0B
		 94 18 B1 23
		 18 44 DC 5A
		 6F 00 00 00
		 0E 00 00 00
		 00 00 F7 07
		 9A CA D1 BA
		 17 00 00 00
		 6D EB 75 ED
		 61 FD E3 00
		 D1 05 A7 02
		 01 07 8B 1B
		 B3 33 CC FF
		 07 10 00 00
		 E4 0F 66 46
		 17 00 40 00
		 7E 01 0A FA
		 FF 00 00 00
		 00 00 00 00
		 00 00 00 00
		 00 00 00 00
		 00 00 00 00
		 00 00 00 00
		 00 00 00 00
		 00 00 00 00
		 00 00 00 00
		 00 00 00 00
		 00 00 00 00
		 00 00 00 00
		 00 00 00 00
		 00 00 00 00
		 00 00 00 00
		 00 00 00 00
		 00 00 00 00
		 00 00 00 00
		 00 00 00 00
	];
};
