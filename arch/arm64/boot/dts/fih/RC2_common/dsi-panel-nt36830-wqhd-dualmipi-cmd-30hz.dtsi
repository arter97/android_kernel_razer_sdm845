/* Copyright (c) 2015, The Linux Foundation. All rights reserved.
 *
 * This program is free software; you can redistribute it and/or modify
 * it under the terms of the GNU General Public License version 2 and
 * only version 2 as published by the Free Software Foundation.
 *
 * This program is distributed in the hope that it will be useful,
 * but WITHOUT ANY WARRANTY; without even the implied warranty of
 * MERCHANTABILITY or FITNESS FOR A PARTICULAR PURPOSE.  See the
 * GNU General Public License for more details.
 */

&mdss_mdp {
	dsi_nt36830_wqhd_dualdsi_cmd_30hz: qcom,mdss_dsi_nt36830_wqhd_dualdsi_cmd_30hz {
		qcom,mdss-dsi-panel-name =
			"NT36830 dual dsi cmd mode 30hz panel with DSC";
		qcom,mdss-dsi-panel-type = "dsi_cmd_mode";
		qcom,mdss-dsi-virtual-channel-id = <0>;
		qcom,mdss-dsi-stream = <0>;
		qcom,mdss-pan-physical-width-dimension = <71>;
		qcom,mdss-pan-physical-height-dimension = <126>;
		qcom,mdss-dsi-bpp = <24>;
		qcom,mdss-dsi-border-color = <0>;
		qcom,mdss-dsi-traffic-mode = "non_burst_sync_event";
		qcom,mdss-dsi-bllp-eof-power-mode;
		qcom,mdss-dsi-tx-eot-append;
		qcom,mdss-dsi-bllp-power-mode;
		qcom,mdss-dsi-lane-0-state;
		qcom,mdss-dsi-lane-1-state;
		qcom,mdss-dsi-lane-2-state;
		qcom,mdss-dsi-lane-3-state;
		qcom,mdss-dsi-dma-trigger = "trigger_sw";
		qcom,mdss-dsi-mdp-trigger = "none";
		qcom,mdss-dsi-reset-sequence = <1 10>, <0 10>, <1 10>;

		qcom,adjust-timer-wakeup-ms = <1>;
		qcom,mdss-dsi-te-pin-select = <1>;
		qcom,mdss-dsi-wr-mem-start = <0x2c>;
		qcom,mdss-dsi-wr-mem-continue = <0x3c>;
		qcom,mdss-dsi-te-dcs-command = <1>;
		qcom,mdss-dsi-te-check-enable;
		qcom,mdss-dsi-te-using-te-pin;
		qcom,ulps-enabled;

		qcom,mdss-dsi-display-timings {
			timing@0 {
				qcom,mdss-dsi-panel-framerate = <120>;
				qcom,mdss-dsi-panel-clockrate = <531000000>;
				qcom,mdss-dsi-panel-width = <720>;
				qcom,mdss-dsi-panel-height = <2560>;
				qcom,mdss-dsi-h-front-porch = <20>;
				qcom,mdss-dsi-h-back-porch = <12>;
				qcom,mdss-dsi-h-pulse-width = <8>;
				qcom,mdss-dsi-h-sync-skew = <0>;
				qcom,mdss-dsi-v-back-porch = <14>;
				qcom,mdss-dsi-v-front-porch = <16>;
				qcom,mdss-dsi-v-pulse-width = <2>;
				qcom,mdss-dsi-h-left-border = <0>;
				qcom,mdss-dsi-h-right-border = <0>;
				qcom,mdss-dsi-v-top-border = <0>;
				qcom,mdss-dsi-v-bottom-border = <0>;
				qcom,mdss-dsi-panel-jitter = <0x8 0xa>;
				
		qcom,mdss-dsi-on-command = [
			15 01 00 00 00 00 02 ff d0
			15 01 00 00 00 00 02 75 40
			15 01 00 00 0a 00 02 f1 40
			15 01 00 00 00 00 02 ff 10
			39 01 00 00 0a 00 06 2c 01 02 04 08 10
			15 01 00 00 00 00 02 ff d0
			15 01 00 00 00 00 02 75 00
			15 01 00 00 0a 00 02 f1 00
			15 01 00 00 00 00 02 ff 10
			15 01 00 00 00 00 02 fb 01
			15 01 00 00 00 00 02 ba 03
			15 01 00 00 00 00 02 bc 08
			15 01 00 00 00 00 02 c0 83
			39 01 00 00 00 00 11 c1 89 28 00 20 02 00 02 68 03 87 00 0a 03 19 02 63
			39 01 00 00 00 00 03 c2 10 F0
			15 01 00 00 00 00 02 d5 00
			15 01 00 00 00 00 02 d6 00
			15 01 00 00 00 00 02 de 00
			15 01 00 00 00 00 02 e1 00
			15 01 00 00 00 00 02 e5 01
			15 01 00 00 00 00 02 bb 10
			15 01 00 00 00 00 02 f6 70
			15 01 00 00 00 00 02 f7 80
			15 01 00 00 00 00 02 35 00
			15 01 00 00 00 00 02 ff 20
			15 01 00 00 00 00 02 fb 01
			15 01 00 00 00 00 02 87 02
			15 01 00 00 00 00 02 5d 00
			15 01 00 00 00 00 02 5e 14
			15 01 00 00 00 00 02 5f eb
			15 01 00 00 00 00 02 ff 24
			15 01 00 00 00 00 02 fb 01
			15 01 00 00 00 00 02 14 00
			15 01 00 00 00 00 02 15 10
			15 01 00 00 00 00 02 16 00
			15 01 00 00 00 00 02 17 10
			15 01 00 00 00 00 02 b4 00
			15 01 00 00 00 00 02 b6 30
			15 01 00 00 00 00 02 ff 26
			15 01 00 00 00 00 02 fb 01
			15 01 00 00 00 00 02 60 00
			15 01 00 00 00 00 02 62 03
			15 01 00 00 00 00 02 40 00
			15 01 00 00 00 00 02 ff 28
			15 01 00 00 00 00 02 fb 01
			15 01 00 00 00 00 02 91 02
			15 01 00 00 00 00 02 ff e0
			15 01 00 00 00 00 02 fb 01
			15 01 00 00 00 00 02 48 81
			15 01 00 00 00 00 02 8e 09
			15 01 00 00 00 00 02 ff f0
			15 01 00 00 00 00 02 fb 01
			15 01 00 00 00 00 02 33 20
			15 01 00 00 00 00 02 34 35
			15 01 00 00 00 00 02 ff 23
			15 01 00 00 00 00 02 fb 01
			15 01 00 00 00 00 02 06 22
			15 01 00 00 00 00 02 ff 10
			39 01 00 00 00 00 03 51 ff ff
			15 01 00 00 00 00 02 55 01
			15 01 00 00 00 00 02 53 2c
			05 01 00 00 78 00 01 11
			05 01 00 00 00 00 01 29
		];

		qcom,mdss-dsi-off-command = [
			29 01 00 00 00 00 02 ff 10
			29 01 00 00 00 00 02 bc 00
			05 01 00 00 22 00 02 28 00
			05 01 00 00 B4 00 02 10 00
		];

		qcom,mdss-dsi-on-command-state = "dsi_hs_mode";
		qcom,mdss-dsi-off-command-state = "dsi_lp_mode";
		qcom,mdss-dsi-h-sync-pulse = <0>;
		qcom,compression-mode = "dsc";
		qcom,mdss-dsc-encoders = <1>;
		qcom,mdss-dsc-slice-height = <32>;
		qcom,mdss-dsc-slice-width = <720>;
		qcom,mdss-dsc-slice-per-pkt = <1>;
		qcom,mdss-dsc-bit-per-component = <8>;
		qcom,mdss-dsc-bit-per-pixel = <8>;
		qcom,mdss-dsc-block-prediction-enable;

		};
	};
};
};
