/* Copyright (c) 2017, The Linux Foundation. All rights reserved.
 *
 * This program is free software; you can redistribute it and/or modify
 * it under the terms of the GNU General Public License version 2 and
 * only version 2 as published by the Free Software Foundation.
 *
 * This program is distributed in the hope that it will be useful,
 * but WITHOUT ANY WARRANTY; without even the implied warranty of
 * MERCHANTABILITY or FITNESS FOR A PARTICULAR PURPOSE.  See the
 * GNU General Public License for more details.
 */

/dts-v1/;
/plugin/;

#include <dt-bindings/clock/qcom,gcc-sdm845.h>
#include <dt-bindings/clock/qcom,camcc-sdm845.h>
#include <dt-bindings/clock/qcom,dispcc-sdm845.h>
#include <dt-bindings/clock/qcom,rpmh.h>
#include <dt-bindings/interrupt-controller/arm-gic.h>

#include "../../qcom/sdm845-sde-display.dtsi"
#include "../../qcom/sdm845-mtp.dtsi"
#include "../../qcom/sdm845-audio-overlay.dtsi"

#include "sdm845-fih-info_rc2-pre-evt2.dtsi"
#include "sdm845-v2-mtp-overlay_rc2-pre-evt2.dtsi"

/ {
	model = "Qualcomm Technologies, Inc. SDM845 v2 MTP, Overlay, RC2 PRE-EVT2";
	compatible = "qcom,sdm845-mtp", "qcom,sdm845", "qcom,mtp";
	qcom,msm-id = <321 0x20000>;
	qcom,board-id = <8 0>;
	fih,hw-id = <2 1 0>;
};

/* Set cmd mode panel without the external clock as the active display */
&mdss_dsi_nt36830_wqhd_dualdsi_extclk_cmd{
/delete-property/qcom,dsi-display-active;
};
&mdss_dsi_nt36830_wqhd_dualdsi_cmd {
	qcom,dsi-display-active;
};
